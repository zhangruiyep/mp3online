## project/Kconfig.proj
```kconfig
#APP specific configuration.
config BF0_HCPU
    bool
    default y

config CUSTOM_MEM_MAP
    bool
	select custom_mem_map
	default y if !SOC_SIMULATOR

config ENABLE_DFU
    bool "enable dfu and add dfu sub-project"
	default n

choice SDK_VERSION
    prompt "SIFLI SDK version"
    default SDK_VERSION_2_5
    config SDK_VERSION_2_5
        bool "2.5"
    config SDK_VERSION_2_4
        bool "2.4"
endchoice

config MP3_RINGBUFF
    bool "enable mp3 ringbuff for stream download and play"
    depends on AUDIO_LOCAL_MUSIC && !SDK_VERSION_2_5
    default y

config LV_GPU_SOFT_DECODER
    bool "enable software decoder for jpeg dynamic load"
    depends on !SDK_VERSION_2_5
    default y

config WEBCLIENT_DEBUG
    bool "enable webclient debug"
    default n

config IMAGE_CACHE_IN_PSRAM_SIZE
    int "image cache size in psram"
    default 1000000

rsource "../src/Kconfig"
```
